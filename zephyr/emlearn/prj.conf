## CMakeLists.txt
```
cmake_minimum_required(VERSION 3.20.0)

find_package(Zephyr REQUIRED HINTS $ENV{ZEPHYR_BASE})
project(emlearn_mlp_minst)

# These samples use local static initialization. Since Zephyr doesn't support the
# C++ ABI for thread-safe initialization of local statics and the constructors don't
# appear to require thread safety, we turn it off in the C++ compiler.
set(NO_THREADSAFE_STATICS $<TARGET_PROPERTY:compiler-cpp,no_threadsafe_statics>)
zephyr_compile_options($<$<COMPILE_LANGUAGE:CXX>:${NO_THREADSAFE_STATICS}>)

file(GLOB app_sources src/*)
target_sources(app PRIVATE ${app_sources})
```

## prj.conf
```kconfig
CONFIG_CPP=y
CONFIG_REQUIRES_FULL_LIBCPP=y
CONFIG_REQUIRES_FULL_LIBC=y
CONFIG_EMLEARN=y
CONFIG_MAIN_STACK_SIZE=2048
CONFIG_REQUIRES_FLOAT_PRINTF=y
CONFIG_TIMING_FUNCTIONS=y
CONFIG_DYNAMIC_INTERRUPTS=y
```

## src/main.c
```c
#include "main_functions.h"

/* Increase number of loops to see repeatable timing output */
#define NUM_LOOPS 50

int main(void)
{
	setup();
	/* Note: Modified from original while(true) to accommodate CI */
	for (int i = 0; i < NUM_LOOPS; i++) {
		loop();
	}
	return 0;
}
```

## src/invoke_profiler.cpp
```c
/*
 * Simple rolling profiler for interpreter->Invoke().
 */

#include "invoke_profiler.h"

#include <zephyr/sys/printk.h>
#include <algorithm>
#include <array>
#include <cmath>

namespace {

constexpr size_t kTimingWindow = 64;
std::array<uint32_t, kTimingWindow> invoke_history = {};
size_t invoke_history_size = 0;

uint64_t invoke_count = 0;
double invoke_mean_us = 0.0;
double invoke_m2 = 0.0;

}  /* namespace */

void LogInvokeStats(uint64_t duration_ns)
{
	const uint32_t delta_us = static_cast < uint32_t > (duration_ns / 1000);

	invoke_count += 1;
	const double delta = static_cast < double > (delta_us) - invoke_mean_us;
	invoke_mean_us += delta / static_cast < double > (invoke_count);
	invoke_m2 += delta * (static_cast < double > (delta_us) - invoke_mean_us);

	const size_t slot = static_cast < size_t > ((invoke_count - 1) % kTimingWindow);
	invoke_history[slot] = delta_us;
	if (invoke_history_size < kTimingWindow) {
		++invoke_history_size;
	}

	std::array<uint32_t, kTimingWindow> tmp = invoke_history;
	std::sort(tmp.begin(), tmp.begin() + invoke_history_size);
	uint32_t median_us = tmp[(invoke_history_size - 1) / 2];
	if ((invoke_history_size % 2) == 0 && invoke_history_size > 1) {
		median_us = static_cast < uint32_t > (
			(tmp[invoke_history_size / 2 - 1] + tmp[invoke_history_size / 2]) / 2);
	}

	const double variance = (invoke_count > 1)
		? (invoke_m2 / static_cast < double > (invoke_count - 1))
		: 0.0;
	const double stddev_us = std::sqrt(variance);

	printk("Invoke ms: last=%.2f mean=%.2f median=%.2f std=%.2f count=%u",
				delta_us / 1000.0,
				invoke_mean_us / 1000.0,
				median_us / 1000.0,
				stddev_us / 1000.0,
				static_cast < unsigned int > (invoke_count));
}
```

## src/invoke_profiler.h
```c
/*
 * Lightweight invoke timing profiler.
 */

#ifndef EMLEARN_MLP_MNIST_INVOKE_PROFILER_H_
#define EMLEARN_MLP_MNIST_INVOKE_PROFILER_H_

#include <cstdint>

/* Record an Invoke duration (nanoseconds) and log rolling stats. */
void LogInvokeStats(uint64_t duration_ns);

#endif  /* EMLEARN_MLP_MNIST_INVOKE_PROFILER_H_ */
```

## src/main_functions.cpp
```c
#include "main_functions.h"

#include <zephyr/kernel.h>
#include <zephyr/sys/printk.h>
#include <zephyr/sys_clock.h>

#include "invoke_profiler.h"
#include "mlp_mnist.h"
#include "mnist_data.cc"

namespace {
	int inference_count = 0;
}

void setup(void)
{
	inference_count = 0;
	printk("emlearn: total samples=%d image=%d\n", kNumSamples, kImageSize);
}

void loop(void)
{
	const int idx = inference_count % kNumSamples;
	const float *sample = kMnistInputs[idx];

	uint32_t start = k_cycle_get_32();
	const int pred = mlp_mnist_predict(sample, kImageSize);
	uint32_t end = k_cycle_get_32();

	const uint32_t cycles = end - start;
	const uint64_t ns = k_cyc_to_ns_floor64(cycles);


	const int label = static_cast<int>(kMnistLabels[idx]);

	printk("\nRAW: cycles=%u ns=%llu pred=%d label=%d\n",
		   (unsigned int)cycles,
		   (unsigned long long)ns,
		   pred,
		   label);

    LogInvokeStats(ns);

	inference_count = (inference_count + 1) % kNumSamples;
}
```

## src/main_functions.h
```c
#ifndef EMLEARN_MLP_MNIST_MAIN_FUNCTIONS_H_
#define EMLEARN_MLP_MNIST_MAIN_FUNCTIONS_H_

/* Expose a C friendly interface for main functions. */
#ifdef __cplusplus
extern "C" {
#endif

/* Initializes all data needed for the example. */
void setup(void);

/* Runs one iteration of data gathering and inference. */
void loop(void);

#ifdef __cplusplus
}
#endif

#endif /* EMLEARN_MLP_MNIST_MAIN_FUNCTIONS_H_ */
```
