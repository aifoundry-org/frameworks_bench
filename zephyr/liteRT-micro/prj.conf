## prj.conf
```kconfig
# Copyright 2019 The TensorFlow Authors. All Rights Reserved.
#
# Licensed under the Apache License, Version 2.0 (the "License");
# you may not use this file except in compliance with the License.
# You may obtain a copy of the License at
#
#    http://www.apache.org/licenses/LICENSE-2.0
#
# Unless required by applicable law or agreed to in writing, software
# distributed under the License is distributed on an "AS IS" BASIS,
# WITHOUT WARRANTIES OR CONDITIONS OF ANY KIND, either express or implied.
# See the License for the specific language governing permissions and
# limitations under the License.
# ==============================================================================s
CONFIG_CPP=y
CONFIG_STD_CPP17=y
CONFIG_TENSORFLOW_LITE_MICRO=y
CONFIG_MAIN_STACK_SIZE=2048
CONFIG_REQUIRES_FLOAT_PRINTF=y
CONFIG_TIMING_FUNCTIONS=y
CONFIG_DYNAMIC_INTERRUPTS=y
```

## src/main.c
```c
/*
 * Copyright 2020 The TensorFlow Authors. All Rights Reserved.
 *
 * Licensed under the Apache License, Version 2.0 (the "License");
 * you may not use this file except in compliance with the License.
 * You may obtain a copy of the License at
 *
 *     http://www.apache.org/licenses/LICENSE-2.0
 *
 * Unless required by applicable law or agreed to in writing, software
 * distributed under the License is distributed on an "AS IS" BASIS,
 * WITHOUT WARRANTIES OR CONDITIONS OF ANY KIND, either express or implied.
 * See the License for the specific language governing permissions and
 * limitations under the License.
 */

#include "main_functions.h"

/* Increase number of loops to see full period of the sine curve */
#define NUM_LOOPS 50

/* This is the default main used on systems that have the standard C entry
 * point. Other devices (for example FreeRTOS or ESP32) that have different
 * requirements for entry code (like an app_main function) should specialize
 * this main.cc file in a target-specific subfolder.
 */
int main(int argc, char *argv[])
{
	setup();
	/* Note: Modified from original while(true) to accommodate CI */
	for (int i = 0; i < NUM_LOOPS; i++) {
		loop();
	}
	return 0;
}
```

## src/invoke_profiler.cpp
```c
/*
 * Simple rolling profiler for interpreter->Invoke().
 */

#include "invoke_profiler.h"

#include <algorithm>
#include <array>
#include <cmath>
#include <tensorflow/lite/micro/micro_log.h>

namespace {

constexpr size_t kTimingWindow = 64;
std::array<uint32_t, kTimingWindow> invoke_history = {};
size_t invoke_history_size = 0;

uint64_t invoke_count = 0;
double invoke_mean_us = 0.0;
double invoke_m2 = 0.0;

}  /* namespace */

void LogInvokeStats(uint64_t duration_ns)
{
	const uint32_t delta_us = static_cast < uint32_t > (duration_ns / 1000);

	invoke_count += 1;
	const double delta = static_cast < double > (delta_us) - invoke_mean_us;
	invoke_mean_us += delta / static_cast < double > (invoke_count);
	invoke_m2 += delta * (static_cast < double > (delta_us) - invoke_mean_us);

	const size_t slot = static_cast < size_t > ((invoke_count - 1) % kTimingWindow);
	invoke_history[slot] = delta_us;
	if (invoke_history_size < kTimingWindow) {
		++invoke_history_size;
	}

	std::array<uint32_t, kTimingWindow> tmp = invoke_history;
	std::sort(tmp.begin(), tmp.begin() + invoke_history_size);
	uint32_t median_us = tmp[(invoke_history_size - 1) / 2];
	if ((invoke_history_size % 2) == 0 && invoke_history_size > 1) {
		median_us = static_cast < uint32_t > (
			(tmp[invoke_history_size / 2 - 1] + tmp[invoke_history_size / 2]) / 2);
	}

	const double variance = (invoke_count > 1)
		? (invoke_m2 / static_cast < double > (invoke_count - 1))
		: 0.0;
	const double stddev_us = std::sqrt(variance);

	MicroPrintf("Invoke ms: last=%.2f mean=%.2f median=%.2f std=%.2f count=%u",
				delta_us / 1000.0,
				invoke_mean_us / 1000.0,
				median_us / 1000.0,
				stddev_us / 1000.0,
				static_cast < unsigned int > (invoke_count));
}
```

## src/invoke_profiler.h
```c
/*
 * Lightweight invoke timing profiler.
 */

#ifndef HELLO_MNIST_INVOKE_PROFILER_H_
#define HELLO_MNIST_INVOKE_PROFILER_H_

#include <cstdint>

/* Record an Invoke duration (nanoseconds) and log rolling stats. */
void LogInvokeStats(uint64_t duration_ns);

#endif  /* HELLO_MNIST_INVOKE_PROFILER_H_ */
```

## src/main_functions.cpp
```c
#include "main_functions.h"

#include <cmath>
#include <cstdint>
#include <zephyr/sys_clock.h>
// #include <zephyr/timing/timing.h>
#include <zephyr/kernel.h>
#include <tensorflow/lite/micro/micro_mutable_op_resolver.h>
#include "constants.h"
#include "model.hpp"
#include "mnist_data.cc"
#include "output_handler.hpp"
#include "invoke_profiler.h"
#include "tensor_printer.h"
#include <tensorflow/lite/micro/micro_log.h>
#include <tensorflow/lite/micro/micro_interpreter.h>
#include <tensorflow/lite/micro/system_setup.h>
#include <tensorflow/lite/schema/schema_generated.h>

/* Globals, used for compatibility with Arduino-style sketches. */
namespace {
	const tflite::Model *model = nullptr;
	tflite::MicroInterpreter *interpreter = nullptr;
	TfLiteTensor *input = nullptr;
	TfLiteTensor *output = nullptr;
	int inference_count = 0;
	int output_size = 0;
	int input_size = 0;

	// constexpr int kTensorArenaSize = 2000;
	constexpr int kTensorArenaSize = 8 * 1024;
	uint8_t tensor_arena[kTensorArenaSize];
	timing_t start_time, end_time;

	uint64_t total_cycles;
    uint64_t total_ns;
}  /* namespace */

/* The name of this function is important for Arduino compatibility. */
void setup(void)
{
	/* Map the model into a usable data structure. This doesn't involve any
	 * copying or parsing, it's a very lightweight operation.
	 */
	model = tflite::GetModel(g_model);
	if (model->version() != TFLITE_SCHEMA_VERSION) {
		MicroPrintf("Model provided is schema version %d not equal "
					"to supported version %d.",
					model->version(), TFLITE_SCHEMA_VERSION);
		return;
	}

	/* This pulls in the operation implementations we need.
	 * NOLINTNEXTLINE(runtime-global-variables)
	 */
	static tflite::MicroMutableOpResolver <2> resolver;
	resolver.AddFullyConnected();
	resolver.AddReshape();

	/* Build an interpreter to run the model with. */
	static tflite::MicroInterpreter static_interpreter(
		model, resolver, tensor_arena, kTensorArenaSize);
	interpreter = &static_interpreter;

	/* Allocate memory from the tensor_arena for the model's tensors. */
	TfLiteStatus allocate_status = interpreter->AllocateTensors();
	if (allocate_status != kTfLiteOk) {
		MicroPrintf("AllocateTensors() failed");
		return;
	}

	/* Obtain pointers to the model's input and output tensors. */
	input = interpreter->input(0);
	output = interpreter->output(0);
	PrintTensorShape("input", input);
	PrintTensorShape("output", output);
	input_size = model->subgraphs()->Get(0)->inputs()->size();

	/* Keep track of how many inferences we have performed. */
	inference_count = 0;

}

/* The name of this function is important for Arduino compatibility. */
void loop(void)
{
	/* Calculate an x value to feed into the model. We compare the current
	 * inference_count to the number of inferences per cycle to determine
	 * our position within the range of possible x values the model was
	 * trained on, and use this to calculate a value.
	 */

	const int sample_index = 2;
	const int sample_shape[1] = {kImageSize};
	const float *sample_data = kMnistInputs[inference_count];
	// PrintMultiDimensional("x", sample_data, sample_shape, 1);

	for (int i = 0; i < kImageSize; ++i) {
		const float pixel = sample_data[i];
		input->data.f[i] = pixel;
	}

	/* Run inference, and report any error */
	uint32_t start = k_cycle_get_32();
	TfLiteStatus invoke_status = interpreter->Invoke();
	uint32_t end   = k_cycle_get_32();

	uint32_t cycles = end - start;
    uint64_t ns     = k_cyc_to_ns_floor64(cycles);

	const int label = static_cast<int>(kMnistLabels[inference_count]);

	MicroPrintf("RAW: cycles=%u ns=%llu ms=%llu",
            (unsigned int)cycles,
            (unsigned long long)ns,
            (unsigned long long)(ns / 1000000ULL));

	LogInvokeStats(ns);
	
	MicroPrintf("Label=%d", label);
	PrintTensor(output);

	/* Increment the inference_counter, and reset it if we have reached
	 * the total number per cycle
	 */
	inference_count += 1;
	if (inference_count >= kInferencesPerCycle) inference_count = 0;
}
```

## src/main_functions.h
```c
#ifndef TENSORFLOW_LITE_MICRO_EXAMPLES_HELLO_WORLD_MAIN_FUNCTIONS_H_
#define TENSORFLOW_LITE_MICRO_EXAMPLES_HELLO_WORLD_MAIN_FUNCTIONS_H_

/* Expose a C friendly interface for main functions. */
#ifdef __cplusplus
extern "C" {
#endif

/* Initializes all data needed for the example. The name is important, and needs
 * to be setup() for Arduino compatibility.
 */
void setup(void);

/* Runs one iteration of data gathering and inference. This should be called
 * repeatedly from the application code. The name needs to be loop() for Arduino
 * compatibility.
 */
void loop(void);

#ifdef __cplusplus
}
#endif

#endif /* TENSORFLOW_LITE_MICRO_EXAMPLES_HELLO_WORLD_MAIN_FUNCTIONS_H_ */
```

## src/tensor_printer.cpp
```c
/*
 * Utility implementation for printing multi-dimensional arrays.
 */

#include "tensor_printer.h"

#include <cstdio>
#include <tensorflow/lite/micro/micro_log.h>

namespace {

constexpr int kMaxDims = 6;
constexpr int kValuesPerLine = 28;

const char *TypeName(TfLiteType type)
{
	switch (type) {
	case kTfLiteInt8: return "int8";
	case kTfLiteUInt8: return "uint8";
	case kTfLiteInt16: return "int16";
	case kTfLiteFloat32: return "float32";
	default: return "unknown";
	}
}

struct LineBuilder {
	char buffer[128];
	int used;

	LineBuilder() : buffer(), used(0) {}

	void Flush(void)
	{
		if (used == 0) return;
		buffer[used] = '\0';
		MicroPrintf("%s", buffer);
		used = 0;
	}

	template <typename... Args>
	void Append(const char *fmt, Args... args)
	{
		int available = static_cast < int > (sizeof(buffer)) - used;
		int written = std::snprintf(buffer + used, available, fmt, args...);
		if (written < 0) return;
		if (written >= available) {
			Flush();
			available = static_cast < int > (sizeof(buffer));
			written = std::snprintf(buffer, available, fmt, args...);
			if (written < 0) return;
			if (written >= available) {
				buffer[available - 1] = '\0';
				MicroPrintf("%s", buffer);
				used = 0;
				return;
			}
			used = written;
			return;
		}
		used += written;
	}
};

template <typename T>
void PrintFlatTensor(const char *label, const T *data, int count)
{
	const char *name = (label != nullptr) ? label : "tensor";
	MicroPrintf("%s shape=[%d] =", name, count);

	LineBuilder line;
	line.Append("[");
	for (int i = 0; i < count; ++i) {
		line.Append("%0.6f", static_cast < double > (data[i]));
		if (i != count - 1) {
			line.Append(", ");
		}

		if (kValuesPerLine > 0 && ((i + 1) % kValuesPerLine) == 0 &&
		    i != count - 1) {
			line.Flush();
		}
	}
	line.Append("]");
	line.Flush();
}

template <typename T>
void PrintMatrixTensor(const char *label, const T *data,
		       const int *shape)
{
	const int rows = shape[0];
	const int cols = shape[1];
	const char *name = (label != nullptr) ? label : "tensor";

	LineBuilder line;
	line.Append("%s shape=[%d, %d] = [", name, rows, cols);
	for (int r = 0; r < rows; ++r) {
		line.Append("[");
		for (int c = 0; c < cols; ++c) {
			const int idx = r * cols + c;
			line.Append("%0.6f", static_cast < double > (data[idx]));
			if (c != cols - 1) line.Append(", ");
		}
		line.Append("]");
		if (r != rows - 1) line.Append(", ");
	}
	line.Append("]\n");
	line.Flush();
}

template <typename T>
void PrintTensorImpl(const char *label, const T *data, const int *shape, int dims)
{
	if (data == nullptr || shape == nullptr || dims <= 0) {
		MicroPrintf("PrintMultiDimensional: invalid arguments");
		return;
	}

	if (dims > kMaxDims) {
		MicroPrintf("PrintMultiDimensional: dims=%d exceeds %d",
			    dims, kMaxDims);
		return;
	}

	if (dims == 1) {
		PrintFlatTensor(label, data, shape[0]);
		return;
	}

	if (dims == 2) {
		PrintMatrixTensor(label, data, shape);
		return;
	}

	int total = 1;
	for (int i = 0; i < dims; ++i) total *= shape[i];

	int indices[kMaxDims];
	for (int flat = 0; flat < total; ++flat) {
		int remainder = flat;
		for (int dim = dims - 1; dim >= 0; --dim) {
			indices[dim] = remainder % shape[dim];
			remainder /= shape[dim];
		}

		char index_buffer[96];
		int written = std::snprintf(index_buffer,
					    sizeof(index_buffer),
					    "%s[",
					    (label != nullptr) ? label
							       : "value");
		if (written < 0) written = 0;
		for (int dim = 0; dim < dims && written < (int)sizeof(index_buffer) - 2;
		     ++dim) {
			written += std::snprintf(index_buffer + written,
						 sizeof(index_buffer) - written,
						 (dim == dims - 1) ? "%d" : "%d, ",
						 indices[dim]);
			if (written < 0) {
				written = 0;
				break;
			}
		}
		std::snprintf(index_buffer + written,
			      sizeof(index_buffer) - written,
			      "]");

		MicroPrintf("%s = %f",
			    index_buffer,
			    static_cast < double > (data[flat]));
	}
}

}  /* namespace */

void PrintMultiDimensional(const char *label,
			   const float *data,
			   const int *shape,
			   int dims)
{
	PrintTensorImpl(label, data, shape, dims);
}

void PrintMultiDimensional(const char *label,
			   const int8_t *data,
			   const int *shape,
			   int dims)
{
	PrintTensorImpl(label, data, shape, dims);
}

void PrintTensorShape(const char *label, const TfLiteTensor *tensor)
{
	const char *name = (label != nullptr) ? label : "tensor";
	if (tensor == nullptr) {
		MicroPrintf("%s tensor is null", name);
		return;
	}

	const TfLiteIntArray *dims = tensor->dims;
	if (dims == nullptr) {
		MicroPrintf("%s tensor has no dims", name);
		return;
	}

	LineBuilder line;
	line.Append("%s shape=[", name);
	for (int i = 0; i < dims->size; ++i) {
		line.Append("%d", dims->data[i]);
		if (i != dims->size - 1) line.Append(", ");
	}
	line.Append("]");
	line.Flush();
}

void PrintTensor(const TfLiteTensor *tensor)
{
	if (tensor == nullptr || tensor->dims == nullptr) {
		MicroPrintf("tensor unavailable");
		return;
	}

	const char *name = (tensor->name != nullptr) ? tensor->name : "tensor";
	const TfLiteIntArray *dims = tensor->dims;
	if (dims->size <= 0 || dims->size > kMaxDims) {
		MicroPrintf("%s dims=%d not supported", name, dims->size);
		return;
	}

	int shape[kMaxDims];
	for (int i = 0; i < dims->size; ++i) shape[i] = dims->data[i];

	MicroPrintf("%s type=%s", name, TypeName(tensor->type));

	switch (tensor->type) {
	case kTfLiteInt8:
		PrintMultiDimensional(name, tensor->data.int8, shape, dims->size);
		break;
	case kTfLiteFloat32:
		PrintMultiDimensional(name, tensor->data.f, shape, dims->size);
		break;
	default:
		MicroPrintf("%s tensor type %d not printable", name, tensor->type);
		break;
	}
}
```

## src/tensor_printer.h
```c
/*
 * Helper utilities for printing multi-dimensional arrays.
 */

#ifndef HELLO_MNIST_TENSOR_PRINTER_H_
#define HELLO_MNIST_TENSOR_PRINTER_H_

#include <cstdint>
#include <tensorflow/lite/c/common.h>

/* Prints the contents of a float tensor with the provided shape. */
void PrintMultiDimensional(const char *label,
			   const float *data,
			   const int *shape,
			   int dims);

/* Prints the contents of an int8_t tensor with the provided shape. */
void PrintMultiDimensional(const char *label,
			   const int8_t *data,
			   const int *shape,
			   int dims);

/* Prints the shape of a TfLiteTensor. */
void PrintTensorShape(const char *label, const TfLiteTensor *tensor);

/* Prints tensor name, type, shape, and all values (supports int8 and float32). */
void PrintTensor(const TfLiteTensor *tensor);

#endif  /* HELLO_MNIST_TENSOR_PRINTER_H_ */
```
